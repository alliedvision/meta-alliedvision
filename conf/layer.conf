## conf/layer.conf
```bitbake
# We have a conf and classes directory, add to BBPATH
BBPATH .= ":${LAYERDIR}"

# We have recipes-* directories, add to BBFILES
BBFILES += "${LAYERDIR}/recipes-*/*/*.bb \
            ${LAYERDIR}/recipes-*/*/*.bbappend"

BBFILE_COLLECTIONS += "alliedvision"
BBFILE_PATTERN_alliedvision = "^${LAYERDIR}/"
BBFILE_PRIORITY_alliedvision = "6"

LAYERDEPENDS_alliedvision = "core openembedded-layer"
LAYERSERIES_COMPAT_alliedvision = "scarthgap"

BBFILES_DYNAMIC += " \
 	qt5-layer:${LAYERDIR}/dynamic-layers/qt5-layer/*/*/*.bb \
	qt5-layer:${LAYERDIR}/dynamic-layers/qt5-layer/*/*/*.bbappend \
 	qt6-layer:${LAYERDIR}/dynamic-layers/qt6-layer/*/*/*.bb \
	qt6-layer:${LAYERDIR}/dynamic-layers/qt6-layer/*/*/*.bbappend \
"
```
